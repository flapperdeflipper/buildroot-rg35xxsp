## br2-external/Config.in
```kconfig
menu "RGOS"
	comment "Board support"
	config BR2_RGOS_LINUX_H700_PATCHES
		bool "Apply the H700 kernel patch set"
		depends on BR2_LINUX_KERNEL
		help
		  Download the Allwinner H700 kernel patches (display engine,
		  panel, backlight, OTG, ...) from the pinned upstream commit
		  (RGOS_ROCKNIX_COMMIT in external.mk) and apply them to the
		  kernel.

	source "$BR2_EXTERNAL_RGOS_PATH/package/rgos-panel-firmware/Config.in"
	source "$BR2_EXTERNAL_RGOS_PATH/package/rgos-uboot-ddr3/Config.in"
	source "$BR2_EXTERNAL_RGOS_PATH/package/rgos-suspend-stub/Config.in"
	source "$BR2_EXTERNAL_RGOS_PATH/package/rgos-padsim/Config.in"

	comment "Desktop"
	source "$BR2_EXTERNAL_RGOS_PATH/package/rgos-desktop/Config.in"
	source "$BR2_EXTERNAL_RGOS_PATH/package/rgos-padd/Config.in"
	source "$BR2_EXTERNAL_RGOS_PATH/package/rgos-oskd/Config.in"
	source "$BR2_EXTERNAL_RGOS_PATH/package/labwc/Config.in"
	source "$BR2_EXTERNAL_RGOS_PATH/package/gtk-layer-shell/Config.in"
	source "$BR2_EXTERNAL_RGOS_PATH/package/sfwbar/Config.in"
	source "$BR2_EXTERNAL_RGOS_PATH/package/wlopm/Config.in"
	source "$BR2_EXTERNAL_RGOS_PATH/package/rgos-power/Config.in"
	source "$BR2_EXTERNAL_RGOS_PATH/package/swayidle/Config.in"
	source "$BR2_EXTERNAL_RGOS_PATH/package/fuzzel/Config.in"
	source "$BR2_EXTERNAL_RGOS_PATH/package/wvkbd/Config.in"
	source "$BR2_EXTERNAL_RGOS_PATH/package/mako/Config.in"
	source "$BR2_EXTERNAL_RGOS_PATH/package/rgos-sdcard/Config.in"

	comment "Apps"
	source "$BR2_EXTERNAL_RGOS_PATH/package/gtksourceview4/Config.in"
	source "$BR2_EXTERNAL_RGOS_PATH/package/mousepad/Config.in"
	source "$BR2_EXTERNAL_RGOS_PATH/package/geany/Config.in"
 	source "$BR2_EXTERNAL_RGOS_PATH/package/weechat/Config.in"
 	source "$BR2_EXTERNAL_RGOS_PATH/package/srain/Config.in"
	source "$BR2_EXTERNAL_RGOS_PATH/package/yt-dlp/Config.in"
	source "$BR2_EXTERNAL_RGOS_PATH/package/rgos-youtube/Config.in"
	source "$BR2_EXTERNAL_RGOS_PATH/package/btop/Config.in"
	source "$BR2_EXTERNAL_RGOS_PATH/package/fzf/Config.in"
	source "$BR2_EXTERNAL_RGOS_PATH/package/glow/Config.in"
	source "$BR2_EXTERNAL_RGOS_PATH/package/progress/Config.in"
	source "$BR2_EXTERNAL_RGOS_PATH/package/prettyping/Config.in"
	source "$BR2_EXTERNAL_RGOS_PATH/package/syncthing/Config.in"
	source "$BR2_EXTERNAL_RGOS_PATH/package/rockbox/Config.in"
	source "$BR2_EXTERNAL_RGOS_PATH/package/rgos-web/Config.in"
endmenu
```

## br2-external/package/btop/Config.in
```kconfig
config BR2_PACKAGE_BTOP
	bool "btop"
	depends on BR2_INSTALL_LIBSTDCPP
	depends on BR2_TOOLCHAIN_GCC_AT_LEAST_11 # C++20
	depends on BR2_TOOLCHAIN_HAS_THREADS
	help
	  Resource monitor: CPU, memory, disks, network and processes.

	  https://github.com/aristocratos/btop
```

## br2-external/package/fuzzel/Config.in
```kconfig
config BR2_PACKAGE_FUZZEL
	bool "fuzzel"
	depends on BR2_PACKAGE_WAYLAND
	depends on BR2_TOOLCHAIN_HAS_THREADS
	select BR2_PACKAGE_FCFT
	select BR2_PACKAGE_FONTCONFIG
	select BR2_PACKAGE_LIBPNG
	select BR2_PACKAGE_LIBXKBCOMMON
	select BR2_PACKAGE_PIXMAN
	select BR2_PACKAGE_TLLIST
	select BR2_PACKAGE_WAYLAND_PROTOCOLS
	help
	  Application launcher and dmenu replacement for wlroots-based
	  Wayland compositors. Fully keyboard driven.

	  https://codeberg.org/dnkl/fuzzel
```

## br2-external/package/fzf/Config.in
```kconfig
config BR2_PACKAGE_FZF
	bool "fzf"
	depends on BR2_PACKAGE_HOST_GO_TARGET_ARCH_SUPPORTS
	select BR2_PACKAGE_HOST_GO
	help
	  Command-line fuzzy finder.

	  https://github.com/junegunn/fzf
```

## br2-external/package/geany/Config.in
```kconfig
config BR2_PACKAGE_GEANY
	bool "geany"
	depends on BR2_PACKAGE_LIBGTK3
	depends on BR2_INSTALL_LIBSTDCPP
	depends on BR2_USE_WCHAR
	help
	  Small and fast GTK3 IDE / code editor: syntax highlighting,
	  symbol lists, build commands, plugins.

	  https://www.geany.org/
```

## br2-external/package/glow/Config.in
```kconfig
config BR2_PACKAGE_GLOW
	bool "glow"
	depends on BR2_PACKAGE_HOST_GO_TARGET_ARCH_SUPPORTS
	select BR2_PACKAGE_HOST_GO
	help
	  Render Markdown in the terminal.

	  https://github.com/charmbracelet/glow
```

## br2-external/package/gtk-layer-shell/Config.in
```kconfig
config BR2_PACKAGE_GTK_LAYER_SHELL
	bool "gtk-layer-shell"
	depends on BR2_PACKAGE_LIBGTK3_WAYLAND
	help
	  Library to create panels and other desktop components for
	  Wayland using the layer-shell protocol (GTK3).

	  https://github.com/wmww/gtk-layer-shell
```

## br2-external/package/gtksourceview4/Config.in
```kconfig
config BR2_PACKAGE_GTKSOURCEVIEW4
	bool "gtksourceview4"
	depends on BR2_PACKAGE_LIBGTK3
	select BR2_PACKAGE_LIBXML2
	help
	  GTK3 text widget with syntax highlighting (API 4), needed by
	  Mousepad. Buildroot's gtksourceview package is the GTK4 (5.x)
	  series.

	  https://gitlab.gnome.org/GNOME/gtksourceview
```

## br2-external/package/labwc/Config.in
```kconfig
config BR2_PACKAGE_LABWC
	bool "labwc"
	depends on BR2_PACKAGE_WLROOTS
	select BR2_PACKAGE_CAIRO
	select BR2_PACKAGE_LIBGLIB2
	select BR2_PACKAGE_LIBPNG
	select BR2_PACKAGE_LIBXML2
	select BR2_PACKAGE_PANGO
	select BR2_PACKAGE_XKEYBOARD_CONFIG # runtime: keymaps (crashes without)
	help
	  Openbox-like stacking Wayland compositor (the window manager
	  of the Raspberry Pi OS desktop): title bars with buttons,
	  root menu, keyboard/mouse bindings, XWayland.

	  https://labwc.github.io
```

## br2-external/package/mako/Config.in
```kconfig
config BR2_PACKAGE_MAKO
	bool "mako"
	depends on BR2_PACKAGE_WAYLAND
	depends on BR2_PACKAGE_SYSTEMD # sd-bus
	select BR2_PACKAGE_CAIRO
	select BR2_PACKAGE_PANGO
	select BR2_PACKAGE_LIBGLIB2
	select BR2_PACKAGE_WAYLAND_PROTOCOLS
	help
	  Lightweight notification daemon for Wayland compositors
	  (org.freedesktop.Notifications).

	  https://github.com/emersion/mako
```

## br2-external/package/mepo/Config.in
```kconfig
config BR2_PACKAGE_MEPO
	bool "mepo"
	depends on BR2_aarch64
	depends on BR2_USE_MMU
	select BR2_PACKAGE_SDL2
	select BR2_PACKAGE_SDL2_TTF
	select BR2_PACKAGE_SDL2_GFX
	select BR2_PACKAGE_SDL2_IMAGE
	select BR2_PACKAGE_LIBCURL
	help
	  mepo: fast, simple OSM map viewer (Zig + SDL2). Online tiles
	  with a disk cache; offline map regions downloadable via CLI
	  (bounding box or radius, multiple zoom levels) into the same
	  cache. Keyboard-first (rebindable), fits the pad nav mode.

	  https://sr.ht/~mil/mepo/

	  Note: built with a pinned host-zig (0.14.1); GPLv3.
```

## br2-external/package/mousepad/Config.in
```kconfig
config BR2_PACKAGE_MOUSEPAD
	bool "mousepad"
	depends on BR2_PACKAGE_LIBGTK3
	select BR2_PACKAGE_GTKSOURCEVIEW4
	help
	  Simple GTK3 text editor (Xfce; the Raspberry Pi OS editor).
	  RGOS uses it as its notes app.

	  https://docs.xfce.org/apps/mousepad/start
```

## br2-external/package/prettyping/Config.in
```kconfig
config BR2_PACKAGE_PRETTYPING
	bool "prettyping"
	depends on BR2_PACKAGE_BASH
	help
	  Wrapper around ping that draws a compact, colourful graph.

	  https://github.com/denilsonsa/prettyping
```

## br2-external/package/progress/Config.in
```kconfig
config BR2_PACKAGE_PROGRESS
	bool "progress"
	depends on BR2_USE_WCHAR
	select BR2_PACKAGE_NCURSES
	select BR2_PACKAGE_NCURSES_WCHAR
	help
	  Shows the progress of running cp, mv, dd, tar, gzip, ... (reads
	  /proc for open files and their offsets).

	  https://github.com/Xfennec/progress
```

## br2-external/package/rgos-bt-firmware/Config.in
```kconfig
config BR2_PACKAGE_RGOS_BT_FIRMWARE
	bool "rgos-bt-firmware"
	depends on BR2_PACKAGE_LINUX_FIRMWARE_RTL_88XX_BT
	help
	  RTL8821CS Bluetooth config blob for the H700 handhelds. Current
	  linux-firmware releases ship only rtl8821cs_fw.bin, but the
	  kernel's btrtl driver still requires rtl8821cs_config.bin
	  (mandatory; without it hci0 fails with out-of-order packets).
	  Taken from the last linux-firmware release that carried the
	  file, the same provenance ROCKNIX uses for this device.

	  https://git.kernel.org/pub/scm/linux/kernel/git/firmware/linux-firmware.git
```

## br2-external/package/rgos-desktop/Config.in
```kconfig
config BR2_PACKAGE_RGOS_DESKTOP
	bool "rgos-desktop"
	depends on BR2_PACKAGE_SYSTEMD_LOGIND
	depends on BR2_PACKAGE_WLROOTS
	depends on BR2_PACKAGE_LIBGTK3_WAYLAND
	select BR2_PACKAGE_LABWC
	select BR2_PACKAGE_SFWBAR
	select BR2_PACKAGE_SWAYBG
	select BR2_PACKAGE_WLOPM
	select BR2_PACKAGE_FOOT
	select BR2_PACKAGE_FUZZEL
	select BR2_PACKAGE_WVKBD
	select BR2_PACKAGE_RGOS_PADD
	select BR2_PACKAGE_RGOS_OSKD
	select BR2_PACKAGE_LINUX_PAM
	select BR2_PACKAGE_JQ # rgos-wifi
	select BR2_PACKAGE_IW
	select BR2_PACKAGE_ALSA_UTILS # rgos-volume
	select BR2_PACKAGE_ALSA_UTILS_AMIXER
	select BR2_PACKAGE_PROCPS_NG # pkill/pgrep/pidof
	select BR2_PACKAGE_SUDO # power menu
	select BR2_PACKAGE_MAKO # notifications
	select BR2_PACKAGE_DEJAVU
	select BR2_PACKAGE_ADWAITA_ICON_THEME
	help
	  RGOS handheld desktop, Raspberry Pi OS style: labwc stacking
	  window manager (title bars, main menu), sfwbar panel (start
	  menu, window list, Wi-Fi/BT/volume/battery/clock), wallpaper,
	  foot terminal, wvkbd on-screen keyboard, rgos-padd button
	  mapping, helper scripts and the autologin session on tty1.
```

## br2-external/package/rgos-game/Config.in
```kconfig
config BR2_PACKAGE_RGOS_GAME
	bool "rgos-game"
	depends on BR2_PACKAGE_SYSTEMD
	select BR2_PACKAGE_RGOS_PADD
	help
	  Game/emulator launcher and system tuning: starts games in
	  games.slice with the Mesa copy-image override for the Mali-G31
	  and the pad in passthrough mode. Ships the RetroArch defaults
	  config and a menu entry when retroarch is enabled.
```

## br2-external/package/rgos-oskd/Config.in
```kconfig
config BR2_PACKAGE_RGOS_OSKD
	bool "rgos-oskd"
	select BR2_PACKAGE_WAYLAND
	help
	  Phone-style on-screen keyboard trigger: watches the focused
	  window (wlr-foreign-toplevel) and shows/hides wvkbd through
	  rgos-padd when a text app is activated and no hardware keyboard
	  is attached. Source in src/oskd.
```

## br2-external/package/rgos-padd/Config.in
```kconfig
config BR2_PACKAGE_RGOS_PADD
	bool "rgos-padd"
	select BR2_PACKAGE_LIBEVDEV
	help
	  Gamepad-to-desktop input daemon: turns handheld buttons into
	  keyboard and mouse events (uinput) with nav, mouse and
	  passthrough modes. Source in src/padd.
```

## br2-external/package/rgos-padsim/Config.in
```kconfig
config BR2_PACKAGE_RGOS_PADSIM
	bool "rgos-padsim"
	select BR2_PACKAGE_LIBEVDEV
	help
	  Simulated handheld controls for the QEMU test image: replays
	  button events from a virtio-serial port (bin/qemu-pad) on uinput
	  devices that look like the RG35XX SP gamepad, keys and lid.
```

## br2-external/package/rgos-panel-firmware/Config.in
```kconfig
config BR2_PACKAGE_RGOS_PANEL_FIRMWARE
	bool "rgos-panel-firmware"
	help
	  LCD panel init sequences for Anbernic H700 handhelds, loaded by
	  the panel-mipi kernel driver from /lib/firmware/panels/.
	  Fetched from a pinned ROCKNIX commit.

	  https://github.com/ROCKNIX/distribution
```

## br2-external/package/rgos-power/Config.in
```kconfig
config BR2_PACKAGE_RGOS_POWER
	bool "rgos-power"
	depends on BR2_PACKAGE_SYSTEMD_LOGIND
	select BR2_PACKAGE_SWAYIDLE
	select BR2_PACKAGE_UTIL_LINUX_RFKILL
	select BR2_PACKAGE_POWERTOP
	help
	  RGOS power management: power readout and logging, idle dimming /
	  screen off / auto-suspend (swayidle), Wi-Fi and Bluetooth off by
	  default with toggles, power profiles, s2idle sleep, battery guard,
	  mDNS. Settings in /etc/rgos/power.conf.
```
