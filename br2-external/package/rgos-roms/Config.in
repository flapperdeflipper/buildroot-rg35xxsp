## br2-external/package/rgos-roms/Config.in
```kconfig
config BR2_PACKAGE_RGOS_ROMS
	bool "rgos-roms"
	depends on BR2_PACKAGE_HOST_PYTHON3
	select BR2_PACKAGE_RETROARCH
	help
	  Self-generated test ROMs for the bundled libretro cores (no
	  third-party content): each boots to a distinctive two-tone or
	  solid test screen so a screenshot proves the core, the video
	  path and audio beep (GB/NES/GBA) work. Menu entries under
	  Applications -> Game launch them through rgos-game.

	  Verified on: nestopia (NES), mGBA (GBA), snes9x (SNES),
	  Genesis-Plus-GX (MD). The gambatte (GB) ROM is generated and
	  installed but has no menu entry yet: it does not render on the
	  gambatte core (known issue, see tmp/agents/HANDOVER.md).
```

## br2-external/package/rgos-sdcard/Config.in
```kconfig
config BR2_PACKAGE_RGOS_SDCARD
	bool "rgos-sdcard"
	depends on BR2_INIT_SYSTEMD
	select BR2_PACKAGE_EXFATPROGS
	select BR2_PACKAGE_DOSFSTOOLS
	select BR2_PACKAGE_DOSFSTOOLS_FSCK_FAT
	select BR2_PACKAGE_E2FSPROGS
	select BR2_PACKAGE_UTIL_LINUX
	select BR2_PACKAGE_UTIL_LINUX_BINARIES # lsblk, findmnt, sfdisk
	select BR2_PACKAGE_SUDO
	help
	  Second SD card: check and mount on insert (exFAT, FAT32, ext4) at
	  /media/sdcard, eject, and format to exFAT from the desktop.
```

## br2-external/package/rgos-services/Config.in
```kconfig
config BR2_PACKAGE_RGOS_SERVICES
	bool "rgos-services"
	help
	  The Services menu: turn optional services on or off from the
	  desktop. First entry: Syncthing's user unit, which ships
	  disabled. Definitions live in /usr/share/rgos/services.d/, one
	  file per service.
```

## br2-external/package/rgos-suspend-stub/Config.in
```kconfig
config BR2_PACKAGE_RGOS_SUSPEND_STUB
	bool "rgos-suspend-stub"
	depends on BR2_TARGET_UBOOT
	depends on BR2_TARGET_UBOOT_BUILD_SYSTEM_KCONFIG
	depends on BR2_TARGET_ARM_TRUSTED_FIRMWARE
	help
	  Build the H700 SRAM suspend stubs (kailashrs' work, as packaged by
	  ROCKNIX) that let TF-A provide PSCI SYSTEM_SUSPEND: real deep sleep
	  with DRAM in self-refresh and resume without losing the session.
	  One stub per memory type (LPDDR3/LPDDR4), compiled from the same
	  U-Boot DRAM driver and parameters as the bootloaders; TF-A embeds
	  both and picks the match at boot (external.mk wires this up).

	  Requires the u-boot and arm-trusted-firmware packages to be enabled.
```

## br2-external/package/rgos-uboot-ddr3/Config.in
```kconfig
config BR2_PACKAGE_RGOS_UBOOT_DDR3
	bool "rgos-uboot-ddr3"
	depends on BR2_TARGET_UBOOT
	depends on BR2_TARGET_UBOOT_BUILD_SYSTEM_KCONFIG
	help
	  Build U-Boot a second time with LPDDR3 DRAM parameters, for H700
	  units that shipped with LPDDR3 instead of LPDDR4. Uses the same
	  source and defconfig as the main U-Boot, plus
	  boards/h700/uboot-ddr3.fragment. Installs
	  u-boot-sunxi-with-spl-lpddr3.bin into the images directory.
```

## br2-external/package/rgos-usbgadget/Config.in
```kconfig
config BR2_PACKAGE_RGOS_USBGADGET
	bool "rgos-usbgadget"
	depends on BR2_PACKAGE_HAS_UDEV
	help
	  USB-C gadget mode: NCM ethernet (ssh over the USB cable, no Wi-Fi
	  needed) plus an ACM serial port. Ships as a systemd service that is
	  OFF by default; turn it on in the Services menu ("USB networking").
	  Device-only (needs the musb UDC).
```

## br2-external/package/rgos-web/Config.in
```kconfig
config BR2_PACKAGE_RGOS_WEB
	bool "rgos-web"
	depends on BR2_PACKAGE_WEBKITGTK
	select BR2_PACKAGE_WEBKITGTK_MINIBROWSER
	select BR2_PACKAGE_WEBKITGTK_HTTPS
	help
	  "Web Browser (WebKit)": the full-web browser, WebKitGTK (Safari's
	  engine) in its MiniBrowser shell, started by rgos-web. NetSurf
	  stays the light one.
```

## br2-external/package/rgos-youtube/Config.in
```kconfig
config BR2_PACKAGE_RGOS_YOUTUBE
	bool "rgos-youtube"
	depends on BR2_PACKAGE_MPV
	depends on BR2_PACKAGE_PYTHON3
	select BR2_PACKAGE_YT_DLP
	help
	  RGOS YouTube app: search, pick from a pad-friendly list, play in
	  mpv (yt-dlp, capped at 480p).
```

## br2-external/package/rockbox/Config.in
```kconfig
config BR2_PACKAGE_ROCKBOX
	bool "rockbox"
	depends on BR2_PACKAGE_SDL2
	depends on BR2_INSTALL_LIBSTDCPP
	depends on BR2_TOOLCHAIN_HAS_THREADS
	help
	  Rockbox music player as a desktop application (SDL), built for a
	  320x240 screen and shown 2x scaled. Plays FLAC, ALAC, MP3, Opus,
	  Vorbis, trackers, ...; patched for keyboard / gamepad control.
	  Started by rgos-rockbox.

	  https://www.rockbox.org/
```

## br2-external/package/sfwbar/Config.in
```kconfig
config BR2_PACKAGE_SFWBAR
	bool "sfwbar"
	depends on BR2_PACKAGE_LIBGTK3_WAYLAND
	select BR2_PACKAGE_GTK_LAYER_SHELL
	select BR2_PACKAGE_JSON_C
	help
	  Flexible taskbar/panel for wlroots compositors: start menu
	  from installed apps, window list, tray, battery, volume,
	  WiFi (iwd) and Bluetooth widgets.

	  https://github.com/LBCrion/sfwbar
```

## br2-external/package/srain/Config.in
```kconfig
config BR2_PACKAGE_SRAIN
	bool "srain"
	depends on BR2_USE_MMU
	select BR2_PACKAGE_LIBCONFIG
	select BR2_PACKAGE_LIBGTK3
	select BR2_PACKAGE_LIBSECRET
	select BR2_PACKAGE_LIBSOUP3
	select BR2_PACKAGE_OPENSSL
	help
	  Srain is a modern IRC client written in GTK. It has a vertical
	  conversation layout and stays usable without a mouse.

	  https://srain.silverrainz.me
```

## br2-external/package/swayidle/Config.in
```kconfig
config BR2_PACKAGE_SWAYIDLE
	bool "swayidle"
	depends on BR2_PACKAGE_WAYLAND
	depends on BR2_PACKAGE_SYSTEMD_LOGIND
	select BR2_PACKAGE_WAYLAND_PROTOCOLS
	help
	  Idle management daemon for Wayland compositors (ext-idle-notify):
	  runs commands after idle timeouts and around suspend.

	  https://github.com/swaywm/swayidle
```

## br2-external/package/syncthing/Config.in
```kconfig
config BR2_PACKAGE_SYNCTHING
	bool "syncthing"
	depends on BR2_PACKAGE_HOST_GO_TARGET_ARCH_SUPPORTS
	help
	  Continuous file synchronization between devices. Installs a session
	  user unit that is disabled by default; enable on request with
	  "systemctl --user enable --now syncthing".

	  https://syncthing.net
```

## br2-external/package/weechat/Config.in
```kconfig
config BR2_PACKAGE_WEECHAT
	bool "weechat"
	depends on BR2_USE_WCHAR
	depends on BR2_TOOLCHAIN_HAS_THREADS
	depends on BR2_USE_MMU
	select BR2_PACKAGE_NCURSES
	select BR2_PACKAGE_NCURSES_WCHAR
	select BR2_PACKAGE_LIBCURL
	select BR2_PACKAGE_GNUTLS
	select BR2_PACKAGE_LIBGCRYPT
	select BR2_PACKAGE_ZLIB
	select BR2_PACKAGE_ZSTD
	select BR2_PACKAGE_CJSON
	help
	  Fast, light and extensible terminal chat client (IRC).
	  Python scripting is enabled when python3 is.

	  https://weechat.org/
```

## br2-external/package/wlopm/Config.in
```kconfig
config BR2_PACKAGE_WLOPM
	bool "wlopm"
	depends on BR2_PACKAGE_WAYLAND
	help
	  Turn Wayland outputs on/off (wlr-output-power-management),
	  without removing them from the layout. Used for the power key
	  and lid.

	  https://git.sr.ht/~leon_plickat/wlopm
```

## br2-external/package/wvkbd/Config.in
```kconfig
config BR2_PACKAGE_WVKBD
	bool "wvkbd"
	depends on BR2_PACKAGE_WAYLAND
	depends on BR2_INSTALL_LIBSTDCPP # pango
	depends on BR2_TOOLCHAIN_HAS_THREADS # pango
	depends on BR2_USE_WCHAR # pango
	select BR2_PACKAGE_CAIRO
	select BR2_PACKAGE_LIBXKBCOMMON
	select BR2_PACKAGE_PANGO
	help
	  On-screen keyboard for wlroots compositors (layer-shell +
	  virtual-keyboard protocols). Installed as wvkbd-mobintl.

	  https://github.com/jjsullivan5196/wvkbd
```

## br2-external/package/yt-dlp/Config.in
```kconfig
config BR2_PACKAGE_YT_DLP
	bool "yt-dlp"
	depends on BR2_PACKAGE_PYTHON3
	select BR2_PACKAGE_PYTHON3_SSL
	select BR2_PACKAGE_PYTHON3_ZLIB
	select BR2_PACKAGE_PYTHON3_SQLITE
	select BR2_PACKAGE_QUICKJS # YouTube needs a JavaScript runtime
	help
	  Video downloader (YouTube and many other sites). Installed as
	  the upstream zipapp, with QuickJS as its JavaScript runtime.

	  https://github.com/yt-dlp/yt-dlp
```

## staging/package/host-zig/Config.in
```kconfig
config BR2_PACKAGE_HOST_ZIG
	bool "host-zig"
	help
	  Pinned official zig 0.14.1 prebuilt for x86_64 Linux. Build-time
	  only; lets zig-based target packages (mepo) cross-compile with
	  zig's bundled glibc stubs instead of bootstrapping the compiler.

	  https://ziglang.org/
```

## staging/package/libretro-gambatte/Config.in
```kconfig
config BR2_PACKAGE_LIBRETRO_GAMBATTE
	bool "libretro-gambatte"
	help
	  Libretro core: Game Boy and Game Boy Color (Gambatte, accuracy
	  focused). The handheld's native screen resolution and button set
	  make GB/GBC a first-class case.

	  https://docs.libretro.com/library/gambatte
```

## staging/package/libretro-genesis-plus-gx/Config.in
```kconfig
config BR2_PACKAGE_LIBRETRO_GENESIS_PLUS_GX
	bool "libretro-genesis-plus-gx"
	help
	  Libretro core: Sega Mega Drive / Genesis, Master System, Game
	  Gear, SG-1000, Sega CD (Genesis Plus GX). Note: its own
	  non-commercial license, not GPL.

	  https://docs.libretro.com/library/genesis_plus_gx
```

## staging/package/libretro-mgba/Config.in
```kconfig
config BR2_PACKAGE_LIBRETRO_MGBA
	bool "libretro-mgba"
	help
	  Libretro core: Game Boy Advance (mGBA). Fast and accurate, the
	  reference GBA emulator.

	  https://docs.libretro.com/library/mgba
```

## staging/package/libretro-nestopia/Config.in
```kconfig
config BR2_PACKAGE_LIBRETRO_NESTOPIA
	bool "libretro-nestopia"
	help
	  Libretro core: Nintendo Entertainment System (Nestopia UE).
	  Accurate NES with good mapper support.

	  https://docs.libretro.com/library/nestopia_ue
```

## staging/package/libretro-snes9x/Config.in
```kconfig
config BR2_PACKAGE_LIBRETRO_SNES9X
	bool "libretro-snes9x"
	help
	  Libretro core: Super Nintendo (Snes9x). Balanced speed/accuracy,
	  the default SNES choice. Note: Snes9x uses its own permissive
	  non-commercial license, not GPL.

	  https://docs.libretro.com/library/snes9x
```

## staging/package/retroarch/Config.in
```kconfig
config BR2_PACKAGE_RETROARCH
	bool "retroarch"
	select BR2_PACKAGE_LIBSDL2
	select BR2_PACKAGE_ALSA_LIB
	select BR2_PACKAGE_FREETYPE
	help
	  Emulator frontend (libretro). Runs cores for Game Boy, GBA, NES,
	  SNES, Mega Drive and more; driven from the handheld buttons via
	  evdev (the rgos-padd passthrough mode hands the pad over).

	  https://www.retroarch.com
```

## staging/package/rtkit/Config.in
```kconfig
config BR2_PACKAGE_RTKIT
	bool "rtkit"
	depends on BR2_INIT_SYSTEMD
	depends on BR2_TOOLCHAIN_HAS_THREADS
	select BR2_PACKAGE_DBUS
	select BR2_PACKAGE_LIBCAP
	help
	  RealtimeKit: D-Bus service granting realtime scheduling
	  (SCHED_FIFO) to user processes. Without it pipewire's
	  module-rt stays SCHED_OTHER (the "RTKit" lines in the journal
	  are the fallback), since user services cannot hold
	  CAP_SYS_NICE themselves.

	  https://github.com/heftig/rtkit
```
